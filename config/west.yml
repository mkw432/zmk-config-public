## config/west.yml
```yaml
manifest:
  remotes:
    - name: zmkfirmware
      url-base: https://github.com/zmkfirmware
    # zmk-dongle-display
    - name: englmaxi
      url-base: https://github.com/englmaxi
    # Additional modules containing boards/shields/custom code can be listed here as well
    # See https://docs.zephyrproject.org/3.2.0/develop/west/manifest.html#projects
    # zmk-rgbled-widget
#    - name: caksoylar
#      url-base: https://github.com/caksoylar
    #zmk-tri-state
#    - name: dhruvinsh
#      url-base: https://github.com/dhruvinsh
  projects:
    - name: zmk
      remote: zmkfirmware
      revision: main
      import: app/west.yml

  # Modules
    - name: zmk-dongle-display
      remote: englmaxi
      revision: main
#    - name: zmk-rgbled-widget
#      remote: caksoylar
#      revision: main
#    - name: zmk-tri-state
#     remote: dhruvinsh
#      revision: main
#    - name: zmk-hid-trackball-interface
#      remote: englmaxi
#      revision: main 
  self:
    path: config
```
